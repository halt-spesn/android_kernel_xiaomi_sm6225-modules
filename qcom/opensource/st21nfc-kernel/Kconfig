## qcom/opensource/st21nfc-kernel/Kconfig
```kconfig
config NFC_ST21NFC
        bool "ST Microelectronics ST21NFC NFC Controller Driver"
        depends on I2C
        help
          ST Microelectronics ST21NFC Near Field Communication controller support.
```

## qcom/opensource/sysfs-torch/Kconfig
```kconfig
config FLASHLIGHT_DRIVER
        tristate "spes brightness control"
        depends on LEDS_CLASS
        help
           GPIO flashlight brighness control for spes.
```
